## kernel/arch/arm/Kconfig.rej
```kconfig
--- arch/arm/Kconfig
+++ arch/arm/Kconfig
@@ -134,10 +134,9 @@
 
 config RWSEM_GENERIC_SPINLOCK
 	bool
-	default y
 
 config RWSEM_XCHGADD_ALGORITHM
-	bool
+	def_bool y
 
 config ARCH_HAS_CPU_IDLE_WAIT
 	bool
```
